## conf/layer.conf
```bitbake
# We have a conf and classes directory, add to BBPATH
BBPATH .= ":${LAYERDIR}"

# We have a packages directory, add to BBFILES
BBFILES += "${LAYERDIR}/recipes-*/*/*.bb \
            ${LAYERDIR}/recipes-*/*/*.bbappend"

BBFILE_COLLECTIONS += "ffmpeg"
BBFILE_PATTERN_ffmpeg := "^${LAYERDIR}/"
BBFILE_PRIORITY_ffmpeg = "4"

LAYERDEPENDS_ffmpeg = "core "
```
